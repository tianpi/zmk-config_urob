## tp-modules/layer-rgb-status-timer/Kconfig
```kconfig
DT_COMPAT_TIANPI_LAYER_RGB_STATUS_TIMER := tianpi,layer-rgb-status-timer

config TIANPI_LAYER_RGB_STATUS_TIMER
    bool
    default $(dt_compat_enabled,$(DT_COMPAT_TIANPI_LAYER_RGB_STATUS_TIMER))
```

## tp-modules/layer-rgb-status-timer/dts/bindings/tianpi,layer-rgb-status-timer.yaml
```yaml
description: Refreshes RGB status while a configured ZMK layer is active

compatible: "tianpi,layer-rgb-status-timer"

properties:
  layer:
    type: int
    required: true
    description: ZMK layer index that enables the timer.
  interval-ms:
    type: int
    default: 5000
    description: Time between RGB status refreshes while the layer is active.
```
