//
////
////////
////////////////
////////////////////////////////
////////////////////////////////////////////////////////////////

#include "moergo_includes.h"
#include "zmk-helpers/key-labels/glove80.h"

#define MOERGO_DEVICE MOERGO_DEVICE_GLOVE80

////////////////////////////////////////////////////////////////

#define KEYS_FINGERS_LEFT  \
    LC5 LC4 LC3 LC2 LC1 \
    LN0 LN1 LN2 LN3 LN4 LN5 \
    LT0 LT1 LT2 LT3 LT4 LT5 \
    LM0 LM1 LM2 LM3 LM4 LM5 \
    LB0 LB1 LB2 LB3 LB4 LB5 \
    LF5 LF4 LF3 LF2 LF1


#define KEYS_FINGERS_RIGHT \
    RC1 RC2 RC3 RC4 RC5 \
    RN5 RN4 RN3 RN2 RN1 RN0 \
    RT0 RT1 RT2 RT3 RT4 RT5 \
    RM0 RM1 RM2 RM3 RM4 RM5 \
    RB0 RB1 RB2 RB3 RB4 RB5 \
    RF1 RF2 RF3 RF4 RF5

#define KEYS_THUMB_LEFT \
    LH5 LH4 LH3 LH2 LH1 LH0

#define KEYS_THUMB_RIGHT \
    RH0 RH1 RH2 RH3 RH4 RH5

#define KEYS_THUMB_LEFT_AND_RIGHT \
    KEYS_THUMB_LEFT KEYS_THUMB_RIGHT

////////////////////////////////////////////////////////////////
// https://github.com/moergo-sc/glove80-zmk-config/blob/main/config/glove80.keymap

/*
/ {
    behaviors {
        magic: magic_hold_tap {
            compatible = "zmk,behavior-hold-tap";
            #binding-cells = <2>;
            flavor = "tap-preferred";
            tapping-term-ms = <200>;
            bindings = <&mo>, <&rgb_ug_status_macro>;
        };
    };

    macros {
        rgb_ug_status_macro: rgb_ug_status_macro_0 {
            compatible = "zmk,behavior-macro";
            #binding-cells = <0>;
            bindings
                = <&rgb_ug RGB_STATUS>;
        };

        bt_0: bt_profile_macro_0 {
            compatible = "zmk,behavior-macro";
            #binding-cells = <0>;
            bindings
                = <&out OUT_BLE>,
                  <&bt BT_SEL 0>;
        };

        bt_1: bt_profile_macro_1 {
            compatible = "zmk,behavior-macro";
            #binding-cells = <0>;
            bindings
                = <&out OUT_BLE>,
                  <&bt BT_SEL 1>;
        };

        bt_2: bt_profile_macro_2 {
            compatible = "zmk,behavior-macro";
            #binding-cells = <0>;
            bindings
                = <&out OUT_BLE>,
                  <&bt BT_SEL 2>;
        };

        bt_3: bt_profile_macro_3 {
            compatible = "zmk,behavior-macro";
            #binding-cells = <0>;
            bindings
                = <&out OUT_BLE>,
                  <&bt BT_SEL 3>;
        };
    };
};

#define KEYMAP_LAYER_FACTORY \
ZMK_LAYER(factory, \
    &kp N0   &kp N6   &kp N2   &kp N8   &kp N4                                                                              &kp N4   &kp N8   &kp N2   &kp N6   &kp N0 \
    &kp N1   &kp N7   &kp N3   &kp N9   &kp N5   &kp N0                                                            &kp N0   &kp N5   &kp N9   &kp N3   &kp N7   &kp N1 \
    &kp N2   &kp N8   &kp N4   &kp N0   &kp N6   &kp N1                                                            &kp N1   &kp N6   &kp N0   &kp N4   &kp N8   &kp N2 \
    &kp N3   &kp N9   &kp N5   &kp N1   &kp N7   &kp N2                                                            &kp N2   &kp N7   &kp N1   &kp N5   &kp N9   &kp N3 \
    &kp N4   &kp N0   &kp N6   &kp N2   &kp N8   &kp N3   &kp N4   &kp N5   &kp N6      &kp N6   &kp N5   &kp N4   &kp N3   &kp N8   &kp N2   &kp N6   &kp N0   &kp N4 \
    &kp N5   &kp N1   &kp N7   &kp N3   &kp N9            &kp N7   &kp N8   &kp N9      &kp N9   &kp N8   &kp N7            &kp N9   &kp N3   &kp N7   &kp N1   &kp N5 \
)

#define KEYMAP_LAYER_MAGIC \
ZMK_LAYER(magic, \
    &bt BT_CLR        &none               &none           &none           &none                                                                                                           &none      &none      &none      &none      &bt BT_CLR_ALL    \
    &none             &none               &none           &none           &none           &none                                                                                &none      &none      &none      &none      &none      &none             \
    &none             &rgb_ug RGB_SPI     &rgb_ug RGB_SAI &rgb_ug RGB_HUI &rgb_ug RGB_BRI &rgb_ug RGB_TOG                                                                      &none      &none      &none      &none      &none      &none             \
    &bootloader       &rgb_ug RGB_SPD     &rgb_ug RGB_SAD &rgb_ug RGB_HUD &rgb_ug RGB_BRD &rgb_ug RGB_EFF                                                                      &none      &none      &none      &none      &none      &bootloader       \
    &sys_reset        &none               &none           &none           &none           &none           &bt_2     &bt_3     &none            &none     &none     &none       &none      &none      &none      &none      &none      &sys_reset        \
    &none             &none               &none           &none           &none                           &bt_0     &bt_1     &out OUT_USB     &none     &none     &none                  &none      &none      &none      &none      &to FACTORY       \
)

*/


////////////////////////////////////////////////////////////////

#define MOERGO_LAYER( \
            name, \
            cl, cr, \
            nl, nr, \
            tl, tr, \
            ml, mr, \
            bl, br, \
            flb, fla, fra, frb, \
            th0la, th0lb, th0rb, th0ra, \
            th1la, th1lb, th1rb, th1ra \
        ) \
        GLV80_LAYER( \
            name, \
            cl cr nl nr tl tr ml mr bl, \
            br flb fla, \
            fra frb, \
            th0la th0lb th0rb th0ra, \
            th1la th1lb th1rb th1ra \
        )

////////////////////////////////////////////////////////////////

#include "moergo.keymap"

////////////////////////////////////////////////////////////////
////////////////////////////////
////////////////
////////
////
//
