//
////
////////
////////////////
////////////////////////////////
////////////////////////////////////////////////////////////////

#include "moergo_includes.h"
#include "moergo_macros.h"

////////////////////////////////////////////////////////////////
// https://zmk.dev/docs/keymaps#multiple-layers

#define __KEYMAP_LAYERS

#define LAYER_BASE        0
#define LAYER_MEDIA       (LAYER_BASE + 1)
#define LAYER_SYS         (LAYER_MEDIA + 1)
#define LAYER_NUM         (LAYER_SYS + 1)
#define LAYER_NUMPAD      (LAYER_NUM + 1)
#define LAYER_SYM         (LAYER_NUMPAD + 1)
#define LAYER_FUN         (LAYER_SYM + 1)
#define LAYER_MACROS      (LAYER_FUN + 1)
#define LAYER_NAV_MOUSE   (LAYER_MACROS + 1)
#define LAYER_NAV         (LAYER_NAV_MOUSE + 1)
#define _LAYER_TEMPLATE   (LAYER_NAV + 1)

////////////////////////////////////////////////////////////////

#define __KEYS

#define XXX             &none
#define ___             &trans
#define NOOP            0

#define KEY_UNDO        LC(Z)
#define KEY_REDO        LC(Y)

#define KEY_CUT         LC(X)
#define KEY_COPY        LC(C)
#define KEY_PASTE       LC(V)

#if MOERGO_OS == MOERGO_OS_WINDOWS_OR_LINUX
#define KEY_MOD_APP_TOGGLE  LALT
#define KEY_APP_TOGGLE      LA(TAB)
#define KEY_APP_WIN_TOGGLE  LA(GRAVE)
#define KEY_APP_QUIT        LA(F4)
#elif MOERGO_OS == MOERGO_OS_MACOS
#define KEY_MOD_APP_TOGGLE  LGUI
#define KEY_APP_TOGGLE      LG(TAB)
#define KEY_APP_WIN_TOGGLE  LG(GRAVE)
#define KEY_APP_QUIT        LG(Q)
#endif

#define KEY_MEH         LA(LC(LSHIFT))
#define KEY_HYPER       LG(KEY_MEH)
#define KEY_META_CTRL   LG(LCTRL)

// Diagonal mouse moves at the same speed as straight moves:
// each axis gets ZMK_POINTING_DEFAULT_MOVE_VAL / sqrt(2) (1/sqrt(2) ~= 7071/10000).
#define MOVE_VAL_DIAGONAL   (ZMK_POINTING_DEFAULT_MOVE_VAL * 7071 / 10000)
#define MOVE_UP_LEFT        MOVE(-MOVE_VAL_DIAGONAL, -MOVE_VAL_DIAGONAL)
#define MOVE_UP_RIGHT       MOVE( MOVE_VAL_DIAGONAL, -MOVE_VAL_DIAGONAL)
#define MOVE_DOWN_LEFT      MOVE(-MOVE_VAL_DIAGONAL,  MOVE_VAL_DIAGONAL)
#define MOVE_DOWN_RIGHT     MOVE( MOVE_VAL_DIAGONAL,  MOVE_VAL_DIAGONAL)

////////////////////////////////////////////////////////////////
// https://zmk.dev/docs/keymaps/behaviors

#define __BEHAVIORS

/ {
    sys_rgb_status_timer: sys_rgb_status_timer {
        compatible = "tianpi,layer-rgb-status-timer";
        layer = <LAYER_SYS>;
        interval-ms = <5000>;
    };
};

// https://zmk.dev/docs/keymaps/behaviors/caps-word
&caps_word {
    /delete-property/ ignore-modifiers; // mods deactivate caps-word, requires PR #1451
};

// https://github.com/urob/zmk-auto-layer/tree/zero-param?tab=readme-ov-file#example-numword
&num_word {
    continue-list = <
        BSPC DEL
        MINUS PLUS
        COMMA
        DOT
    >;
};

// // https://zmk.dev/docs/keymaps/behaviors/sticky-key
// &sk {
//     release-after-ms = <900>;  // release after 0.6s
//     quick-release;             // no double capitalization when rolling keys
// };

// // https://zmk.dev/docs/keymaps/behaviors/sticky-layer
// &sl {
//     ignore-modifiers;          // allow chording sticky mods & layers
// };

// // https://zmk.dev/docs/keymaps/behaviors/layers#layer-tap
// &lt {
//     flavor = "balanced";
//     tapping-term-ms = <200>;
//     quick-tap-ms = <175>;
// };

// // https://zmk.dev/docs/keymaps/behaviors/mod-tap#mod-tap
// &mt {
//     flavor = "tap-preferred";
//     tapping-term-ms = <220>;
//     quick-tap-ms = <220>;
//     hold-trigger-key-positions = <0>;
// };

////////////////////////////////////////////////////////////////
// https://zmk.dev/docs/keymaps/behaviors/hold-tap

#define ____BEHAVIOURS__HOLD_TAP__HRM

/*

## HRM variants

Hold input \ Tap input | Key (&kp)          | Mod-morph (&mm)
-----------------------|--------------------|------------------------------
Key (&kp)              | [L,R]HRM_KP_KP     | [L,R]HRM_KP_MM
Layer (&mo)            | [L,R]HRM_MO_KP     | [L,R]HRM_MO_MM
Macro                  | [L,R]HRM_MACRO_KP  | [L,R]HRM_MACRO_MM
Layer + modifier       | [L,R]HRM_MO_MOD_KP | [L,R]HRM_MO_MOD_MM

## Example

ZMK_HOLD_TAP_HRM
  → creates 'lhrm_kp_kp' *behavior*
    → LHRM_KP_KP supplies its hold and tap parameters at a keymap position

'lhrm_kp_kp' is a named *ZMK behavior*, defined by:
    ZMK_HOLD_TAP_HRM(lhrm_kp_kp, &kp, &kp, KEYS_LHRM_HOLD_TRIGGER)
A keymap binding is its use at a physical key position, with arguments, for example:
    &LHRM_KP_KP(LEFT_META, W)

So this *keymap binding*:
    &LHRM_KP_KP(LEFT_META, W)
preprocesses to:
    &lhrm_kp_kp LEFT_META W

The other LHRM_* / RHRM_* macros follow the same pattern:
generic factory → concrete behavior instance → short keymap-facing alias.

## Naming patterns

Everything follows a coherent convention:

[L,R]HRM_<hold behavior>_<tap behavior>
ZMK_HOLD_TAP_xHRM_<hold behavior>_<tap behavior>
[l,r]hrm_<hold behavior>_<tap behavior>[_specific tap behavior]

## Glossary

- `ZMK`: the keyboard firmware framework that provides the behavior system.
- `[L,R]`: compact notation meaning both the left and right HRM variants.
- `[l,r]`: compact notation meaning both the left (`l`) and right (`r`) behavior variants.
- `HRM`: home-row-mod hold-tap behavior with positional triggering.
- `KP`: key-press behavior (`&kp`).
- `MO`: momentary-layer behavior (`&mo`).
- `MM`: mod-morph behavior.
- `MACRO`: macro behavior used as the hold binding.
- `MOD`: fixed modifier held together with a layer.
- `xHRM`: generator that creates both left- and right-hand HRM variants.
- `[l,r]hrm_*`: named left/right ZMK hold-tap behavior instances used by the keymap aliases.
- `KEYS_LHRM_HOLD_TRIGGER` / `KEYS_RHRM_HOLD_TRIGGER`: opposite-hand positions that trigger the corresponding HRM hold.
- `macro_mo_kp_*`: named parameterized macro behavior that holds a layer plus a fixed modifier.
- `ZMK_HOLD_TAP_HRM`: factory macro that creates one HRM behavior with shared timing and positional-trigger settings.
- `NOOP`: zero-valued placeholder for an unused behavior parameter.

Behavior names are limited to 47 visible characters by Zephyr, so generated behavior names may use abbreviations.

*/

// Creates the named HRM behavior with the shared timing and positional-trigger policy.
#define ZMK_HOLD_TAP_HRM(name, hold_binding, tap_binding, hold_trigger_key_positions) \
    ZMK_HOLD_TAP(name, \
        bindings = <hold_binding>, <tap_binding>; \
        flavor = "balanced"; \
        tapping-term-ms = <MOERGO_HOLD_TAP__TAPPING_TERM_MS>; \
        quick-tap-ms = <MOERGO_HOLD_TAP__QUICK_TAP_MS>; \
        require-prior-idle-ms = <MOERGO_HOLD_TAP__REQUIRE_PRIOR_IDLE_MS>; \
        hold-trigger-key-positions = <hold_trigger_key_positions>; \
        hold-trigger-on-release; \
    )

// While an HRM is undecided, a key from its opposite-hand hold-trigger set resolves it as a hold;
// a same-hand key resolves it as a tap. `hold-trigger-on-release` makes this decision when the
// following key releases. Holding the HRM alone beyond the tapping term also resolves it as hold.
#define KEYS_LHRM_HOLD_TRIGGER \
    KEYS_FINGERS_RIGHT \
    KEYS_THUMB_RIGHT
#define KEYS_RHRM_HOLD_TRIGGER \
    KEYS_FINGERS_LEFT \
    KEYS_THUMB_LEFT

// Creates [l,r]hrm_<name> behaviors with the supplied hold and tap bindings.
#define ZMK_HOLD_TAP_xHRM(name, hold_binding, tap_binding) \
    ZMK_HOLD_TAP_HRM(lhrm_ ## name, hold_binding, tap_binding, KEYS_LHRM_HOLD_TRIGGER) \
    ZMK_HOLD_TAP_HRM(rhrm_ ## name, hold_binding, tap_binding, KEYS_RHRM_HOLD_TRIGGER)

////////////////

// Creates [l,r]hrm_kp_kp behaviors that hold one keycode and tap another.
ZMK_HOLD_TAP_xHRM(kp_kp, &kp, &kp)

// Provides [l,r]hrm_kp_kp behaviors that hold one keycode and tap another.
#define LHRM_KP_KP(key_on_hold, key_on_tap) lhrm_kp_kp key_on_hold key_on_tap
#define RHRM_KP_KP(key_on_hold, key_on_tap) rhrm_kp_kp key_on_hold key_on_tap

// Creates [l,r]hrm_mo_kp behaviors that hold a layer and tap a keycode.
ZMK_HOLD_TAP_xHRM(mo_kp, &mo, &kp)

// Provides [l,r]hrm_mo_kp behaviors that hold a layer and tap a keycode.
#define LHRM_MO_KP(layer_on_hold, key_on_tap) lhrm_mo_kp layer_on_hold key_on_tap
#define RHRM_MO_KP(layer_on_hold, key_on_tap) rhrm_mo_kp layer_on_hold key_on_tap

////////////////

// Creates [l,r]hrm_kp_mm_<mod-morph> behaviors that hold a keycode and tap a mod-morph.
#define ZMK_HOLD_TAP_xHRM_KP_MM(mm_on_tap) \
    ZMK_HOLD_TAP_xHRM(kp_mm_ ## mm_on_tap, &kp, &mm_on_tap)

// Creates [l,r]hrm_mo_mm_<mod-morph> behaviors that hold a layer and tap a mod-morph.
#define ZMK_HOLD_TAP_xHRM_MO_MM(mm_on_tap) \
    ZMK_HOLD_TAP_xHRM(mo_mm_ ## mm_on_tap, &mo, &mm_on_tap)

// Creates both keycode-hold and layer-hold HRM behavior pairs for one mod-morph tap behavior.
#define ZMK_HOLD_TAP_xHRM_KP_AND_MO_MM(mm_on_tap) \
    ZMK_HOLD_TAP_xHRM_KP_MM(mm_on_tap) \
    ZMK_HOLD_TAP_xHRM_MO_MM(mm_on_tap)

// Provides [l,r]hrm_kp_mm_<mod-morph> behaviors that hold a keycode and tap a mod-morph.
#define LHRM_KP_MM(key_on_hold, mm_on_tap) lhrm_kp_mm_ ## mm_on_tap key_on_hold NOOP
#define RHRM_KP_MM(key_on_hold, mm_on_tap) rhrm_kp_mm_ ## mm_on_tap key_on_hold NOOP

// Provides [l,r]hrm_mo_mm_<mod-morph> behaviors that hold a layer and tap a mod-morph.
#define LHRM_MO_MM(layer_on_hold, mm_on_tap) lhrm_mo_mm_ ## mm_on_tap layer_on_hold NOOP
#define RHRM_MO_MM(layer_on_hold, mm_on_tap) rhrm_mo_mm_ ## mm_on_tap layer_on_hold NOOP

////////////////

// Creates [l,r]hrm_macro_kp_<macro> behaviors that hold a macro and tap a keycode.
#define ZMK_HOLD_TAP_xHRM_MACRO_KP(macro_on_hold) \
    ZMK_HOLD_TAP_xHRM(macro_kp_ ## macro_on_hold, &macro_on_hold, &kp)

// Creates [l,r]hrm_macro_mm_<macro>_<mod-morph> behaviors that hold a macro and tap a mod-morph.
#define ZMK_HOLD_TAP_xHRM_MACRO_MM(macro_on_hold, mm_on_tap) \
    ZMK_HOLD_TAP_xHRM(macro_mm_ ## macro_on_hold ## _ ## mm_on_tap, &macro_on_hold, &mm_on_tap)

// Provides [l,r]hrm_macro_kp_<macro> behaviors that hold a macro and tap a keycode.
#define LHRM_MACRO_KP(macro_on_hold, key_on_tap) lhrm_macro_kp_ ## macro_on_hold NOOP key_on_tap
#define RHRM_MACRO_KP(macro_on_hold, key_on_tap) rhrm_macro_kp_ ## macro_on_hold NOOP key_on_tap

// Provides [l,r]hrm_macro_mm_<macro>_<mod-morph> behaviors that hold a macro and tap a mod-morph.
#define LHRM_MACRO_MM(macro_on_hold, mm_on_tap, macro_param) lhrm_macro_mm_ ## macro_on_hold ## _ ## mm_on_tap macro_param NOOP
#define RHRM_MACRO_MM(macro_on_hold, mm_on_tap, macro_param) rhrm_macro_mm_ ## macro_on_hold ## _ ## mm_on_tap macro_param NOOP

////////////////

// Creates macro_mo_kp_<modifier> behaviors that hold a layer plus a fixed modifier and tap a keycode.
// Layer and keycode are provided as parameters to the macro, while the modifier is fixed in the macro name.
#define ZMK_MACRO_ONE_PARAM_MO_KP(name, mod_on_hold) \
    ZMK_MACRO_ONE_PARAM(name, \
        wait-ms = <0>; \
        tap-ms = <0>; \
        bindings \
            = <&macro_param_1to1> \
            , <&macro_press &mo MACRO_PLACEHOLDER &kp mod_on_hold> \
            , <&macro_pause_for_release> \
            , <&macro_release &kp mod_on_hold> \
            , <&macro_param_1to1> \
            , <&macro_release &mo MACRO_PLACEHOLDER> \
            ; \
    )

// Creates macro_mo_kp_<modifier> plus [l,r]hrm_mo_mod_kp_<modifier> behaviors.
#define ZMK_HOLD_TAP_xHRM_MO_MOD_KP(mod_on_hold) \
    ZMK_MACRO_ONE_PARAM_MO_KP(macro_mo_kp_ ## mod_on_hold, mod_on_hold) \
    ZMK_HOLD_TAP_xHRM(mo_mod_kp_ ## mod_on_hold, &macro_mo_kp_ ## mod_on_hold, &kp)

// Provides macro_mo_kp_KEY_MEH plus [l,r]hrm_mo_mod_kp_KEY_MEH behaviors.
ZMK_HOLD_TAP_xHRM_MO_MOD_KP(KEY_MEH)

// Provides [l,r]hrm_mo_mod_kp_<modifier> behaviors that hold a layer plus modifier and tap a keycode.
#define LHRM_MO_MOD_KP(layer_on_hold, mod_on_hold, key_on_tap) lhrm_mo_mod_kp_ ## mod_on_hold layer_on_hold key_on_tap
#define RHRM_MO_MOD_KP(layer_on_hold, mod_on_hold, key_on_tap) rhrm_mo_mod_kp_ ## mod_on_hold layer_on_hold key_on_tap

// Creates [l,r]hrm_mo_mod_mm_<modifier>_<mod-morph> behaviors that hold a layer plus modifier and tap a mod-morph.
#define ZMK_HOLD_TAP_xHRM_MO_MOD_MM(mod_on_hold, mm_on_tap) \
    ZMK_HOLD_TAP_xHRM(mo_mod_mm_ ## mod_on_hold ## _ ## mm_on_tap, &macro_mo_kp_ ## mod_on_hold, &mm_on_tap)

// Provides [l,r]hrm_mo_mod_mm_<modifier>_<mod-morph> behaviors that hold a layer plus modifier and tap a mod-morph.
#define LHRM_MO_MOD_MM(layer_on_hold, mod_on_hold, mm_on_tap) lhrm_mo_mod_mm_ ## mod_on_hold ## _ ## mm_on_tap layer_on_hold NOOP
#define RHRM_MO_MOD_MM(layer_on_hold, mod_on_hold, mm_on_tap) rhrm_mo_mod_mm_ ## mod_on_hold ## _ ## mm_on_tap layer_on_hold NOOP

////////////////////////////////////////////////////////////////
// https://zmk.dev/docs/keymaps/behaviors/macros

#define ____BEHAVIOURS__MACRO

////////////////////////////////

ZMK_MACRO(macro_reset_keyboard_and_switch_to_base_layer,
    wait-ms = <0>;
    tap-ms = <5>;
    bindings = <&kp K_CANCEL>, <&to LAYER_BASE>; // reset keyboard and switch to base layer
)

ZMK_HOLD_TAP(ht__reset_keyboard_and_go_to_base_layer__kp,
    flavor = "balanced";
    tapping-term-ms = <MOERGO_HOLD_TAP__TAPPING_TERM_MS>;
    quick-tap-ms = <MOERGO_HOLD_TAP__QUICK_TAP_MS>;
    bindings = <&macro_reset_keyboard_and_switch_to_base_layer>, <&kp>;
)

////////////////

ZMK_MACRO(macro_browser_new_search_tab,
    bindings
        = <&kp LC(T)> // new tab
        , <&kp LC(K)> // focus address bar
        , <&kp KEY_PASTE> // paste
        ;
)

////////////////

ZMK_MACRO(macro_copy_and_toggle_app_and_paste,
    bindings
        = <&kp LC(L)> // focus address bar of source app
        , <&kp KEY_COPY> // copy
        , <&kp KEY_APP_TOGGLE> // toggle to target app (that has file dialog open)
        , <&kp HOME>  // (optional) go to beginning of line
        , <&kp KEY_PASTE> // paste
        ;
)

////////////////

ZMK_MACRO(macro_std_cpp,
    bindings
        = <&kp S &kp T &kp D &kp COLON &kp COLON> // std::
        ;
)


////////////////////////////////////////////////////////////////
// https://zmk.dev/docs/keymaps/behaviors/mod-morph

#define ____BEHAVIOURS__MOD_MORPH

////////////////////////////////

// tap -> BACKSPACE | LSFT + tap -> DELETE | RSFT + tap -> RSFT-DELETE
ZMK_MOD_MORPH(mm_backspace_delete,
    bindings = <&kp BSPC>, <&kp DEL>;
    mods = <(MOD_LSFT|MOD_RSFT)>;
    keep-mods = <MOD_RSFT>;
)
ZMK_HOLD_TAP_xHRM_KP_AND_MO_MM(mm_backspace_delete)

////////////////////////////////

// Defines a shift-sensitive mod-morph and its compatible HRM variants.
#define ZMK_MOD_MORPH_SIMPLE(name, mod, binding1, binding2) \
    ZMK_MOD_MORPH(name, \
        mods = <(MOD_L ## mod | MOD_R ## mod)>; \
        bindings = <binding1>, <binding2>; \
    ) \
    ZMK_HOLD_TAP_xHRM_KP_AND_MO_MM(name)


ZMK_MOD_MORPH_SIMPLE(mm_add_sub, SFT, &kp PLUS, &kp MINUS)
ZMK_MOD_MORPH_SIMPLE(mm_and_or, SFT, &kp AMPERSAND, &kp PIPE)
ZMK_MOD_MORPH_SIMPLE(mm_brackets, SFT, &kp LEFT_BRACKET, &kp RIGHT_BRACKET)
ZMK_MOD_MORPH_SIMPLE(mm_braces, SFT, &kp LEFT_BRACE, &kp RIGHT_BRACE)
ZMK_MOD_MORPH_SIMPLE(mm_caret_underscore, SFT, &kp CARET, &kp UNDERSCORE)
ZMK_MOD_MORPH_SIMPLE(mm_comma_semicolon, SFT, &kp COMMA, &kp SEMICOLON)
ZMK_MOD_MORPH_SIMPLE(mm_comma_singlequote, SFT, &kp COMMA, &kp SINGLE_QUOTE)
ZMK_MOD_MORPH_SIMPLE(mm_doublequotes_singlequote, SFT, &kp DOUBLE_QUOTES, &kp SINGLE_QUOTE)
ZMK_MOD_MORPH_SIMPLE(mm_dot_colon, SFT, &kp DOT, &kp COLON)
ZMK_MOD_MORPH_SIMPLE(mm_dot_doublequotes, SFT, &kp DOT, &kp DOUBLE_QUOTES)
ZMK_MOD_MORPH_SIMPLE(mm_enter_escape, SFT, &kp ENTER, &kp ESCAPE)
ZMK_MOD_MORPH_SIMPLE(mm_equal_equal, SFT, &kp EQUAL, &kp EQUAL)
ZMK_MOD_MORPH_SIMPLE(mm_excl_qmark, SFT, &kp EXCLAMATION, &kp QMARK)
ZMK_MOD_MORPH_SIMPLE(mm_grave_caret, SFT, &kp GRAVE, &kp CARET)
ZMK_MOD_MORPH_SIMPLE(mm_lt_gt, SFT, &kp LESS_THAN, &kp GREATER_THAN)
ZMK_MOD_MORPH_SIMPLE(mm_minus_plus, SFT, &kp MINUS, &kp PLUS)
ZMK_MOD_MORPH_SIMPLE(mm_mul_div, SFT, &kp ASTERISK, &kp SLASH)
ZMK_MOD_MORPH_SIMPLE(mm_parenthesis, SFT, &kp LEFT_PARENTHESIS, &kp RIGHT_PARENTHESIS)
ZMK_MOD_MORPH_SIMPLE(mm_pointer_reference, SFT, &kp ASTERISK, &kp AMPERSAND)
ZMK_MOD_MORPH_SIMPLE(mm_semicolon_semicolon, SFT, &kp SEMICOLON, &kp SEMICOLON)
ZMK_MOD_MORPH_SIMPLE(mm_slash_backslash, SFT, &kp SLASH, &kp BACKSLASH)
ZMK_MOD_MORPH_SIMPLE(mm_underscore_equal, SFT, &kp UNDERSCORE, &kp EQUAL)
ZMK_MOD_MORPH_SIMPLE(mm_underscore_minus, SFT, &kp UNDERSCORE, &kp MINUS)

ZMK_MOD_MORPH_SIMPLE(mm_keypad_add_sub, SFT, &kp KP_PLUS, &kp KP_MINUS)
ZMK_MOD_MORPH_SIMPLE(mm_keypad_dot_comma, SFT, &kp KP_DOT, &kp KP_COMMA)
ZMK_MOD_MORPH_SIMPLE(mm_keypad_mul_div, SFT, &kp KP_ASTERISK, &kp KP_SLASH)
ZMK_MOD_MORPH_SIMPLE(mm_keypad_parenthesis, SFT, &kp KP_LEFT_PARENTHESIS, &kp KP_RIGHT_PARENTHESIS)


////////////////////////////////////////////////////////////////
// https://zmk.dev/docs/config/combos

#define ____BEHAVIOURS__COMBO

////////////////

#define COMBO_TERM_FAST 18
#define COMBO_TERM_SLOW 30

#define COMBO_IDLE_FAST 150
#define COMBO_IDLE_SLOW 50

////////////////

// ZMK_COMBO(combo_lm4_rm4, &to LAYER_SYS, LM4 RM4, ALL, COMBO_TERM_FAST, COMBO_IDLE_FAST)  // switch to system layer

////////////////////////////////////////////////////////////////

#define ____BEHAVIOURS__TRI_STATE

/*
https://github.com/dhruvinsh/zmk-tri-state:
- Pressing tri-state will fire the first behavior, and output A, as well as the second behavior, outputting B.
- Subsequent presses of tri-state will output B.
- When another key is pressed or a layer change occurs, the third, 'interrupt' behavior C will fire.

For example:
- A is pressing and holding KEY_MOD_APP_TOGGLE (by toggling it ON),
- B is pressing Tab, and
- C is releasing KEY_MOD_APP_TOGGLE (by toggling it OFF).
*/

// Defines a tri-state forward app switcher that holds Alt/GUI and repeatedly sends Tab.
#define ZMK_TRI_STATE__APP_SWITCH_FORWARD(name, ...)          \
    ZMK_TRI_STATE(                                    \
        name,                                         \
        bindings = <&kt KEY_MOD_APP_TOGGLE>, <&kp TAB>, <&kt KEY_MOD_APP_TOGGLE>; \
        __VA_ARGS__ \
    )

ZMK_TRI_STATE__APP_SWITCH_FORWARD(
    tri__app_switch_fw__nav_left,
#if MOERGO_DEVICE == MOERGO_DEVICE_GLOVE80
    ignored-key-positions =
    <
        LF5 LF4 LF3 LF1 LH1 LH0
    >;
#endif
)

ZMK_TRI_STATE__APP_SWITCH_FORWARD(
    tri__app_switch_fw__nav_right,
    ignored-key-positions =
    <
        RT1 RT2 RT3
        RM1 RM2 RM3
        RB1     RB3
    >;
)

// Defines a tri-state forward app-window switcher that repeatedly sends Grave.
#define ZMK_TRI_STATE__APP_WIN_SWITCH_FORWARD(name, ...)          \
    ZMK_TRI_STATE(                                    \
        name,                                         \
        bindings = <&kt KEY_MOD_APP_TOGGLE>, <&kp GRAVE>, <&kt KEY_MOD_APP_TOGGLE>; \
        __VA_ARGS__ \
    )

ZMK_TRI_STATE__APP_WIN_SWITCH_FORWARD(
    tri__app_win_switch_fw,
    ignored-key-positions =
    <
        RT1 RT2 RT3
        RM1 RM2 RM3
        RB1     RB3
    >;
)

// Defines a tri-state backward app-window switcher that repeatedly sends Shift+Grave.
#define ZMK_TRI_STATE__APP_WIN_SWITCH_BACKWARD(name, ...)          \
    ZMK_TRI_STATE(                                    \
        name,                                         \
        bindings = <&kt KEY_MOD_APP_TOGGLE>, <&kp LS(GRAVE)>, <&kt KEY_MOD_APP_TOGGLE>; \
        __VA_ARGS__ \
    )

ZMK_TRI_STATE__APP_WIN_SWITCH_BACKWARD(
    tri__app_win_switch_bw,
    ignored-key-positions =
    <
        RT1 RT2 RT3
        RM1 RM2 RM3
        RB1     RB3
    >;
)


////////////////////////////////////////////////////////////////

#define __KEYMAP

#define ____KEYMAP_LAYER_BASE

MOERGO_LAYER(layer_base,
// ╭─────┬─────┬─────┬─────┬─────╮           ╭─────┬─────┬─────┬─────┬─────╮
// │ LC5 │ LC4 │ LC3 │ LC2 │ LC1 │           │ RC1 │ RC2 │ RC3 │ RC4 │ RC5 │
    XXX
    XXX
    XXX
    XXX
    XXX
    ,
    XXX
    XXX
    XXX
    XXX
    XXX
    ,
// ├─────┼─────┼─────┼─────┼─────┼─────┬─────┼─────┼─────┼─────┼─────┼─────┤
// │ LN5 │ LN4 │ LN3 │ LN2 │ LN1 │ LN0 │ RN0 │ RN1 │ RN2 │ RN3 │ RN4 │ RN5 │
    &kp ESCAPE

    &kp DEL
    &kp LC(PAGE_UP)
    &kp KEY_APP_TOGGLE
    &kp LC(PAGE_DOWN)
    &kp KEY_UNDO
    ,
    &kp KEY_REDO
    &kp LA(LEFT_ARROW)
    &kp LC(SPACE)
    &kp LA(RIGHT_ARROW)
    &kp BSPC

    &kp ENTER
    ,
// ├─────┼─────┼─────┼─────┼─────┼─────┼─────┼─────┼─────┼─────┼─────┼─────┤
// │ LT5 │ LT4 │ LT3 │ LT2 │ LT1 │ LT0 │ RT0 │ RT1 │ RT2 │ RT3 │ RT4 │ RT5 │
    &mo LAYER_MEDIA

    &kp Q
    &LHRM_KP_KP(LEFT_META, W)
    &LHRM_MO_KP(LAYER_NUM, E)
    &LHRM_MO_KP(LAYER_SYM, R)
    &kp F
    ,
    &kp Y
    &RHRM_MO_KP(LAYER_SYM, U)
    &RHRM_MO_KP(LAYER_NUMPAD, I)
    &RHRM_KP_KP(LEFT_META, O)
    &kp SINGLE_QUOTE

    &caps_word
    ,
// ├─────┼─────┼─────┼─────┼─────┼─────┼─────┼─────┼─────┼─────┼─────┼─────┤
// │ LM5 │ LM4 │ LM3 │ LM2 │ LM1 │ LM0 │ RM0 │ RM1 │ RM2 │ RM3 │ RM4 │ RM5 │
    &kp ENTER

    &LHRM_KP_KP(LALT, A)
    &LHRM_KP_KP(LCTL, S)
    &LHRM_MO_KP(LAYER_SYM, D)
    &LHRM_KP_KP(LSFT, T)
    &LHRM_KP_KP(KEY_MEH, G)
    ,
    &RHRM_KP_KP(KEY_MEH, K)
    &RHRM_KP_KP(LSFT, N)
    &RHRM_MO_KP(LAYER_SYM, H)
    &RHRM_KP_KP(LCTL, L)
    &RHRM_KP_KP(LALT, P)

    &ht__reset_keyboard_and_go_to_base_layer__kp NOOP ESCAPE
    ,
// ├─────┼─────┼─────┼─────┼─────┼─────┼─────┼─────┼─────┼─────┼─────┼─────┤
// │ LB5 │ LB4 │ LB3 │ LB2 │ LB1 │ LB0 │ RB0 │ RB1 │ RB2 │ RB3 │ RB4 │ RB5 │
    &kp LCTRL

    &LHRM_KP_KP(RIGHT_ALT, Z)
    &LHRM_KP_KP(KEY_META_CTRL, X)
    &kp C
    &kp V
    &LHRM_KP_KP(KEY_HYPER, B)
    ,
    &RHRM_KP_KP(KEY_HYPER, J)
    &kp M
    &mm_comma_semicolon
    &RHRM_KP_MM(KEY_META_CTRL, mm_dot_colon)
    &RHRM_KP_MM(RIGHT_ALT, mm_excl_qmark)

    &kp CAPSLOCK
    ,
// ├─────┼─────┼─────┼─────┼─────┼─────┴─────┼─────┼─────┼─────┼─────┼─────┤
// │ LF5 │ LF4 │ LF3 │ LF2 │ LF1 │           │ RF1 │ RF2 │ RF3 │ RF4 │ RF5 │
    &kp HOME
    &kp PAGE_UP
    ,
    &kp LCTRL
    &kp SPACE
    &kp PRINTSCREEN
    ,
    XXX
    XXX
    XXX
    ,
    XXX
    XXX
    ,
// ├─────┼─────┼─────┼─────┴─────╯           ╰─────┴─────┼─────┼─────┼─────┤
// │ LH5 │ LH4 │ LH3 │                                   │ RH3 │ RH4 │ RH5 │
    &LHRM_MO_MM(LAYER_NAV, mm_backspace_delete)
    // RHRM is used because, while the mouse is operated with the right hand,
    // the modifier is combined with keys from the left hand side.
    &RHRM_KP_MM(LEFT_CONTROL, mm_minus_plus)
    ,
    &kp PRINTSCREEN
    ,
    XXX
    ,
    &RHRM_MO_MM(LAYER_MACROS, mm_underscore_equal)
    &RHRM_MO_KP(LAYER_FUN, SPACE)
    ,
// ├─────┼─────┼─────┤                                   ├─────┼─────┼─────┤
// │ LH2 │ LH1 │ LH0 │                                   │ RH0 │ RH1 │ RH2 │
    &LHRM_MO_MM(LAYER_NAV_MOUSE, mm_slash_backslash)
    ,
    &kp PAGE_DOWN
    &kp END
    ,
    XXX
    XXX
    ,
    &kp TAB
// ╰─────┴─────┴─────╯                                   ╰─────┴─────┴─────╯
)

////////////////////////////////////////////////////////////////

#define ____KEYMAP_LAYER_MEDIA

MOERGO_LAYER(layer_media,
// ╭─────┬─────┬─────┬─────┬─────╮           ╭─────┬─────┬─────┬─────┬─────╮
// │ LC5 │ LC4 │ LC3 │ LC2 │ LC1 │           │ RC1 │ RC2 │ RC3 │ RC4 │ RC5 │
     ___   ___   ___   ___   ___       ,       ___   ___   ___   ___   ___,
// ├─────┼─────┼─────┼─────┼─────┼─────┬─────┼─────┼─────┼─────┼─────┼─────┤
// │ LN5 │ LN4 │ LN3 │ LN2 │ LN1 │ LN0 │ RN0 │ RN1 │ RN2 │ RN3 │ RN4 │ RN5 │
    XXX
    XXX
    &kp C_BRIGHTNESS_INC
    &kp C_PREVIOUS
    &kp C_VOLUME_UP
    XXX
    ,
    XXX
    XXX
    XXX
    XXX
    XXX
    &to LAYER_SYS
    ,

// ├─────┼─────┼─────┼─────┼─────┼─────┼─────┼─────┼─────┼─────┼─────┼─────┤
// │ LT5 │ LT4 │ LT3 │ LT2 │ LT1 │ LT0 │ RT0 │ RT1 │ RT2 │ RT3 │ RT4 │ RT5 │
    ___

    XXX
    &kp C_BRIGHTNESS_DEC
    &kp C_NEXT
    &kp C_VOLUME_DOWN
    XXX
    ,
    XXX
    XXX
    XXX
    XXX
    XXX

    ___
    ,
// ├─────┼─────┼─────┼─────┼─────┼─────┼─────┼─────┼─────┼─────┼─────┼─────┤
// │ LM5 │ LM4 │ LM3 │ LM2 │ LM1 │ LM0 │ RM0 │ RM1 │ RM2 │ RM3 │ RM4 │ RM5 │
    ___

    XXX
    XXX
    &kp C_PLAY_PAUSE
    &kp C_MUTE
    XXX
    ,
    XXX
    XXX
    XXX
    XXX
    XXX

    ___
    ,
// ├─────┼─────┼─────┼─────┼─────┼─────┼─────┼─────┼─────┼─────┼─────┼─────┤
// │ LB5 │ LB4 │ LB3 │ LB2 │ LB1 │ LB0 │ RB0 │ RB1 │ RB2 │ RB3 │ RB4 │ RB5 │
    ___

    XXX
    XXX
    XXX
    XXX
    XXX
    ,
    XXX
    XXX
    XXX
    XXX
    XXX

    ___
    ,
// ├─────┼─────┼─────┼─────┼─────┼─────┴─────┼─────┼─────┼─────┼─────┼─────┤
// │ LF5 │ LF4 │ LF3 │ LF2 │ LF1 │           │ RF1 │ RF2 │ RF3 │ RF4 │ RF5 │
     ___   ___ , ___   ___   ___       ,       ___   ___   ___ , ___   ___,
// ├─────┼─────┼─────┼─────┴─────╯           ╰─────┴─────┼─────┼─────┼─────┤
// │ LH5 │ LH4 │ LH3 │                                   │ RH3 │ RH4 │ RH5 │
     ___   ___ , ___                   ,                   ___ , ___   ___,
// ├─────┼─────┼─────┤                                   ├─────┼─────┼─────┤
// │ LH2 │ LH1 │ LH0 │                                   │ RH0 │ RH1 │ RH2 │
     ___ , ___   ___                   ,                   ___   ___ , ___
// ╰─────┴─────┴─────╯                                   ╰─────┴─────┴─────╯
)

////////////////////////////////////////////////////////////////

#define ____KEYMAP_LAYER_SYS

MOERGO_LAYER(layer_sys,
// ╭─────┬─────┬─────┬─────┬─────╮           ╭─────┬─────┬─────┬─────┬─────╮
// │ LC5 │ LC4 │ LC3 │ LC2 │ LC1 │           │ RC1 │ RC2 │ RC3 │ RC4 │ RC5 │
     ___   ___   ___   ___   ___       ,       ___   ___   ___   ___   ___,
// ├─────┼─────┼─────┼─────┼─────┼─────┬─────┼─────┼─────┼─────┼─────┼─────┤
// │ LN5 │ LN4 │ LN3 │ LN2 │ LN1 │ LN0 │ RN0 │ RN1 │ RN2 │ RN3 │ RN4 │ RN5 │
     ___   ___   ___   ___   ___   ___ , ___   ___   ___   ___   ___   ___,
// ├─────┼─────┼─────┼─────┼─────┼─────┼─────┼─────┼─────┼─────┼─────┼─────┤
// │ LT5 │ LT4 │ LT3 │ LT2 │ LT1 │ LT0 │ RT0 │ RT1 │ RT2 │ RT3 │ RT4 │ RT5 │
    ___

    &rgb_ug RGB_ON
    &rgb_ug RGB_COLOR_HSB(0,100,100) // red
    &rgb_ug RGB_EFF // effect forward
    &rgb_ug RGB_SPI // speed increase
    &out OUT_BLE // switch to BLE
    ,
    &bt BT_CLR // clear current BT device
    &bt BT_PRV // switch to previous BT device
    XXX
    &bt BT_NXT // switch to next BT device
    XXX

    ___
    ,
// ├─────┼─────┼─────┼─────┼─────┼─────┼─────┼─────┼─────┼─────┼─────┼─────┤
// │ LM5 │ LM4 │ LM3 │ LM2 │ LM1 │ LM0 │ RM0 │ RM1 │ RM2 │ RM3 │ RM4 │ RM5 │
    ___

    &rgb_ug RGB_TOG
    &rgb_ug RGB_COLOR_HSB(120,100,100) // green
    &rgb_ug RGB_STATUS
    XXX
    &out OUT_TOG  // toggle USB/BLE
    ,
    XXX
    &bt BT_SEL 0 // select BT device N
    &bt BT_SEL 1
    &bt BT_SEL 2
    &bt BT_SEL 3

    ___
    ,
// ├─────┼─────┼─────┼─────┼─────┼─────┼─────┼─────┼─────┼─────┼─────┼─────┤
// │ LB5 │ LB4 │ LB3 │ LB2 │ LB1 │ LB0 │ RB0 │ RB1 │ RB2 │ RB3 │ RB4 │ RB5 │
    ___

    &rgb_ug RGB_OFF
    &rgb_ug RGB_COLOR_HSB(240,100,100) // blue
    &rgb_ug RGB_EFR // effect reverse
    &rgb_ug RGB_SPD // speed decrease
    &out OUT_USB  // switch to USB
    ,
    &bt BT_CLR_ALL // clear all paired BT devices
    &bt BT_DISC 0  // disconnect BT device N
    &bt BT_DISC 1
    &bt BT_DISC 2
    &bt BT_DISC 3

    ___
    ,
// ├─────┼─────┼─────┼─────┼─────┼─────┴─────┼─────┼─────┼─────┼─────┼─────┤
// │ LF5 │ LF4 │ LF3 │ LF2 │ LF1 │           │ RF1 │ RF2 │ RF3 │ RF4 │ RF5 │
     ___   ___ , ___   ___   ___       ,       ___   ___   ___ , ___   ___,
// ├─────┼─────┼─────┼─────┴─────╯           ╰─────┴─────┼─────┼─────┼─────┤
// │ LH5 │ LH4 │ LH3 │                                   │ RH3 │ RH4 │ RH5 │
     ___   ___ , ___                   ,                   ___ , ___   ___,
// ├─────┼─────┼─────┤                                   ├─────┼─────┼─────┤
// │ LH2 │ LH1 │ LH0 │                                   │ RH0 │ RH1 │ RH2 │
     ___ , ___   ___                   ,                   ___   ___ , ___
// ╰─────┴─────┴─────╯                                   ╰─────┴─────┴─────╯
)

////////////////////////////////////////////////////////////////

/*

#define ____KEYMAP_LAYER_FACTORY

KEYMAP_LAYER_FACTORY

*/

////////////////////////////////////////////////////////////////

/*

#define ____KEYMAP_LAYER_MAGIC

KEYMAP_LAYER_MAGIC

*/

////////////////////////////////////////////////////////////////

#define ____KEYMAP_LAYER_NUM

MOERGO_LAYER(layer_num,
// ╭─────┬─────┬─────┬─────┬─────╮           ╭─────┬─────┬─────┬─────┬─────╮
// │ LC5 │ LC4 │ LC3 │ LC2 │ LC1 │           │ RC1 │ RC2 │ RC3 │ RC4 │ RC5 │
     ___   ___   ___   ___   ___       ,       ___   ___   ___   ___   ___,
// ├─────┼─────┼─────┼─────┼─────┼─────┬─────┼─────┼─────┼─────┼─────┼─────┤
// │ LN5 │ LN4 │ LN3 │ LN2 │ LN1 │ LN0 │ RN0 │ RN1 │ RN2 │ RN3 │ RN4 │ RN5 │
     ___   ___   ___   ___   ___   ___ , ___   ___   ___   ___   ___   ___,
// ├─────┼─────┼─────┼─────┼─────┼─────┼─────┼─────┼─────┼─────┼─────┼─────┤
// │ LT5 │ LT4 │ LT3 │ LT2 │ LT1 │ LT0 │ RT0 │ RT1 │ RT2 │ RT3 │ RT4 │ RT5 │
	___

    XXX
    &kp COLON
    XXX /* LAYER -> THIS */
    &mo LAYER_SYM
    &kp LEFT_SHIFT
    ,
    &kp STAR
    &kp N7
    &kp N8
    &kp N9
    &kp PLUS

    ___
    ,
// ├─────┼─────┼─────┼─────┼─────┼─────┼─────┼─────┼─────┼─────┼─────┼─────┤
// │ LM5 │ LM4 │ LM3 │ LM2 │ LM1 │ LM0 │ RM0 │ RM1 │ RM2 │ RM3 │ RM4 │ RM5 │
    ___

    &kp SEMICOLON
    &kp DOT
    XXX
    &kp COMMA
    &kp COLON
    ,
    &kp EQUAL
    &kp N4
    &kp N5
    &kp N6
    &kp N0

    ___
    ,
// ├─────┼─────┼─────┼─────┼─────┼─────┼─────┼─────┼─────┼─────┼─────┼─────┤
// │ LB5 │ LB4 │ LB3 │ LB2 │ LB1 │ LB0 │ RB0 │ RB1 │ RB2 │ RB3 │ RB4 │ RB5 │
    ___

    XXX
    XXX
    XXX
    XXX
    XXX
    ,
    &kp SLASH
    &kp N1
    &kp N2
    &kp N3
    &kp MINUS

    ___
    ,
// ├─────┼─────┼─────┼─────┼─────┼─────┴─────┼─────┼─────┼─────┼─────┼─────┤
// │ LF5 │ LF4 │ LF3 │ LF2 │ LF1 │           │ RF1 │ RF2 │ RF3 │ RF4 │ RF5 │
    ___
    ___
    ,
    ___
    ___
    ___
    ,
    &mm_comma_semicolon
    &kp N0
    &mm_dot_colon
    ,
    ___
    ___
    ,
// ├─────┼─────┼─────┼─────┴─────╯           ╰─────┴─────┼─────┼─────┼─────┤
// │ LH5 │ LH4 │ LH3 │                                   │ RH3 │ RH4 │ RH5 │
     ___   ___ , ___                   ,                   ___ , ___   ___,
// ├─────┼─────┼─────┤                                   ├─────┼─────┼─────┤
// │ LH2 │ LH1 │ LH0 │                                   │ RH0 │ RH1 │ RH2 │
     ___ , ___   ___                   ,                   ___   ___ , ___
// ╰─────┴─────┴─────╯                                   ╰─────┴─────┴─────╯
)


////////////////////////////////////////////////////////////////

#define ____KEYMAP_LAYER_NUMPAD

MOERGO_LAYER(layer_numpad,
// ╭─────┬─────┬─────┬─────┬─────╮           ╭─────┬─────┬─────┬─────┬─────╮
// │ LC5 │ LC4 │ LC3 │ LC2 │ LC1 │           │ RC1 │ RC2 │ RC3 │ RC4 │ RC5 │
     ___   ___   ___   ___   ___       ,       ___   ___   ___   ___   ___,
// ├─────┼─────┼─────┼─────┼─────┼─────┬─────┼─────┼─────┼─────┼─────┼─────┤
// │ LN5 │ LN4 │ LN3 │ LN2 │ LN1 │ LN0 │ RN0 │ RN1 │ RN2 │ RN3 │ RN4 │ RN5 │
     ___   ___   ___   ___   ___   ___ , ___   ___   ___   ___   ___   ___,
// ├─────┼─────┼─────┼─────┼─────┼─────┼─────┼─────┼─────┼─────┼─────┼─────┤
// │ LT5 │ LT4 │ LT3 │ LT2 │ LT1 │ LT0 │ RT0 │ RT1 │ RT2 │ RT3 │ RT4 │ RT5 │
    ___

    &kp KP_PLUS
    &kp KP_N7
    &kp KP_N8
    &kp KP_N9
    &kp KP_ASTERISK
    ,
    XXX
    &mo LAYER_SYM
    XXX /* LAYER -> THIS */
    XXX
    XXX

    ___
    ,
// ├─────┼─────┼─────┼─────┼─────┼─────┼─────┼─────┼─────┼─────┼─────┼─────┤
// │ LM5 │ LM4 │ LM3 │ LM2 │ LM1 │ LM0 │ RM0 │ RM1 │ RM2 │ RM3 │ RM4 │ RM5 │
    ___

    &kp KP_N0
    &kp KP_N4
    &kp KP_N5
    &kp KP_N6
    &kp KP_EQUAL
    ,
    XXX
    &kp KP_COMMA
    XXX
    &kp KP_DOT
    XXX

    ___
    ,
// ├─────┼─────┼─────┼─────┼─────┼─────┼─────┼─────┼─────┼─────┼─────┼─────┤
// │ LB5 │ LB4 │ LB3 │ LB2 │ LB1 │ LB0 │ RB0 │ RB1 │ RB2 │ RB3 │ RB4 │ RB5 │
    ___

    &kp KP_MINUS
    &kp KP_N1
    &kp KP_N2
    &kp KP_N3
    &kp KP_SLASH
    ,
    XXX
    XXX
    XXX
    XXX
    XXX

    ___
    ,
// ├─────┼─────┼─────┼─────┼─────┼─────┴─────┼─────┼─────┼─────┼─────┼─────┤
// │ LF5 │ LF4 │ LF3 │ LF2 │ LF1 │           │ RF1 │ RF2 │ RF3 │ RF4 │ RF5 │
     ___   ___ , ___   ___   ___       ,       ___   ___   ___ , ___   ___,
// ├─────┼─────┼─────┼─────┴─────╯           ╰─────┴─────┼─────┼─────┼─────┤
// │ LH5 │ LH4 │ LH3 │                                   │ RH3 │ RH4 │ RH5 │
     ___   ___ , ___                   ,                   ___ , ___   ___,
// ├─────┼─────┼─────┤                                   ├─────┼─────┼─────┤
// │ LH2 │ LH1 │ LH0 │                                   │ RH0 │ RH1 │ RH2 │
     ___ , ___   ___                   ,                   ___   ___ , ___
// ╰─────┴─────┴─────╯                                   ╰─────┴─────┴─────╯
)

////////////////////////////////////////////////////////////////

#define ____KEYMAP_LAYER_SYM

MOERGO_LAYER(layer_sym,
// ╭─────┬─────┬─────┬─────┬─────╮           ╭─────┬─────┬─────┬─────┬─────╮
// │ LC5 │ LC4 │ LC3 │ LC2 │ LC1 │           │ RC1 │ RC2 │ RC3 │ RC4 │ RC5 │
     ___   ___   ___   ___   ___       ,       ___   ___   ___   ___   ___,
// ├─────┼─────┼─────┼─────┼─────┼─────┬─────┼─────┼─────┼─────┼─────┼─────┤
// │ LN5 │ LN4 │ LN3 │ LN2 │ LN1 │ LN0 │ RN0 │ RN1 │ RN2 │ RN3 │ RN4 │ RN5 │
     ___   ___   ___   ___   ___   ___ , ___   ___   ___   ___   ___   ___,
// ├─────┼─────┼─────┼─────┼─────┼─────┼─────┼─────┼─────┼─────┼─────┼─────┤
// │ LT5 │ LT4 │ LT3 │ LT2 │ LT1 │ LT0 │ RT0 │ RT1 │ RT2 │ RT3 │ RT4 │ RT5 │
    ___

    &kp AT_SIGN
    &kp AMPERSAND
    &kp PLUS
    &kp ASTERISK
    &kp BACKSLASH
    ,
    &kp SINGLE_QUOTE
    &kp LEFT_BRACE
    &kp HASH
    &kp RIGHT_BRACE
    &mm_doublequotes_singlequote

    ___
    ,
// ├─────┼─────┼─────┼─────┼─────┼─────┼─────┼─────┼─────┼─────┼─────┼─────┤
// │ LM5 │ LM4 │ LM3 │ LM2 │ LM1 │ LM0 │ RM0 │ RM1 │ RM2 │ RM3 │ RM4 │ RM5 │
    ___

    &mm_grave_caret
    &kp LESS_THAN
    &mm_equal_equal
    &LHRM_KP_KP(LSFT, GREATER_THAN)
    &kp CARET
    ,
    &kp COLON
    &RHRM_KP_KP(LSFT, LEFT_PARENTHESIS)
    &kp DOLLAR
    &kp RIGHT_PARENTHESIS
    &kp SEMICOLON

    ___
    ,
// ├─────┼─────┼─────┼─────┼─────┼─────┼─────┼─────┼─────┼─────┼─────┼─────┤
// │ LB5 │ LB4 │ LB3 │ LB2 │ LB1 │ LB0 │ RB0 │ RB1 │ RB2 │ RB3 │ RB4 │ RB5 │
    ___

    &kp TILDE
    &kp PIPE
    &kp MINUS
    &mm_slash_backslash
    &kp UNDERSCORE
    ,
    &kp QUESTION
    &kp LEFT_BRACKET
    &kp PERCENT
    &kp RIGHT_BRACKET
    &mm_excl_qmark

    ___
    ,
// ├─────┼─────┼─────┼─────┼─────┼─────┴─────┼─────┼─────┼─────┼─────┼─────┤
// │ LF5 │ LF4 │ LF3 │ LF2 │ LF1 │           │ RF1 │ RF2 │ RF3 │ RF4 │ RF5 │
     ___   ___ , ___   ___   ___       ,       ___   ___   ___ , ___   ___,
// ├─────┼─────┼─────┼─────┴─────╯           ╰─────┴─────┼─────┼─────┼─────┤
// │ LH5 │ LH4 │ LH3 │                                   │ RH3 │ RH4 │ RH5 │
     ___   ___ , ___                   ,                   ___ , ___   ___,
// ├─────┼─────┼─────┤                                   ├─────┼─────┼─────┤
// │ LH2 │ LH1 │ LH0 │                                   │ RH0 │ RH1 │ RH2 │
     ___ , ___   ___                   ,                   ___   ___ , ___
// ╰─────┴─────┴─────╯                                   ╰─────┴─────┴─────╯
)


////////////////////////////////////////////////////////////////

#define ____KEYMAP_LAYER_FUN

MOERGO_LAYER(layer_fun,
// ╭─────┬─────┬─────┬─────┬─────╮           ╭─────┬─────┬─────┬─────┬─────╮
// │ LC5 │ LC4 │ LC3 │ LC2 │ LC1 │           │ RC1 │ RC2 │ RC3 │ RC4 │ RC5 │
     ___   ___   ___   ___   ___       ,       ___   ___   ___   ___   ___,
// ├─────┼─────┼─────┼─────┼─────┼─────┬─────┼─────┼─────┼─────┼─────┼─────┤
// │ LN5 │ LN4 │ LN3 │ LN2 │ LN1 │ LN0 │ RN0 │ RN1 │ RN2 │ RN3 │ RN4 │ RN5 │
     ___   ___   ___   ___   ___   ___ , ___   ___   ___   ___   ___   ___,
// ├─────┼─────┼─────┼─────┼─────┼─────┼─────┼─────┼─────┼─────┼─────┼─────┤
// │ LT5 │ LT4 │ LT3 │ LT2 │ LT1 │ LT0 │ RT0 │ RT1 │ RT2 │ RT3 │ RT4 │ RT5 │
    ___

    &kp F1
    &kp F4
    &kp F7
    &kp F10
    &kp INSERT
    ,
    &kp KP_NUMLOCK
    &kp F22
    &kp F19
    &kp F16
    &kp F13

    ___
    ,
// ├─────┼─────┼─────┼─────┼─────┼─────┼─────┼─────┼─────┼─────┼─────┼─────┤
// │ LM5 │ LM4 │ LM3 │ LM2 │ LM1 │ LM0 │ RM0 │ RM1 │ RM2 │ RM3 │ RM4 │ RM5 │
    ___

    &kp F2
    &kp F5
    &kp F8
    &kp F11
    &kp PRINTSCREEN
    ,
    &kp CAPSLOCK
    &kp F23
    &kp F20
    &kp F17
    &kp F14

    ___
    ,
// ├─────┼─────┼─────┼─────┼─────┼─────┼─────┼─────┼─────┼─────┼─────┼─────┤
// │ LB5 │ LB4 │ LB3 │ LB2 │ LB1 │ LB0 │ RB0 │ RB1 │ RB2 │ RB3 │ RB4 │ RB5 │
    &kp PRINTSCREEN

    &kp F3
    &kp F6
    &kp F9
    &kp F12
    &kp PAUSE_BREAK
    ,
    &kp SCROLLLOCK
    &kp F24
    &kp F21
    &kp F18
    &kp F15

    ___
    ,
// ├─────┼─────┼─────┼─────┼─────┼─────┴─────┼─────┼─────┼─────┼─────┼─────┤
// │ LF5 │ LF4 │ LF3 │ LF2 │ LF1 │           │ RF1 │ RF2 │ RF3 │ RF4 │ RF5 │
     ___   ___ , ___   ___   ___       ,       ___   ___   ___ , ___   ___,
// ├─────┼─────┼─────┼─────┴─────╯           ╰─────┴─────┼─────┼─────┼─────┤
// │ LH5 │ LH4 │ LH3 │                                   │ RH3 │ RH4 │ RH5 │
     ___   ___ , ___                   ,                   ___ , ___   ___,
// ├─────┼─────┼─────┤                                   ├─────┼─────┼─────┤
// │ LH2 │ LH1 │ LH0 │                                   │ RH0 │ RH1 │ RH2 │
     ___ , ___   ___                   ,                   ___   ___ , ___
// ╰─────┴─────┴─────╯                                   ╰─────┴─────┴─────╯
)

////////////////////////////////////////////////////////////////

#define ____KEYMAP_LAYER_MACROS

MOERGO_LAYER(layer_macros,
// ╭─────┬─────┬─────┬─────┬─────╮           ╭─────┬─────┬─────┬─────┬─────╮
// │ LC5 │ LC4 │ LC3 │ LC2 │ LC1 │           │ RC1 │ RC2 │ RC3 │ RC4 │ RC5 │
     ___   ___   ___   ___   ___       ,       ___   ___   ___   ___   ___,
// ├─────┼─────┼─────┼─────┼─────┼─────┬─────┼─────┼─────┼─────┼─────┼─────┤
// │ LN5 │ LN4 │ LN3 │ LN2 │ LN1 │ LN0 │ RN0 │ RN1 │ RN2 │ RN3 │ RN4 │ RN5 │
     ___   ___   ___   ___   ___   ___ , ___   ___   ___   ___   ___   ___,
// ├─────┼─────┼─────┼─────┼─────┼─────┼─────┼─────┼─────┼─────┼─────┼─────┤
// │ LT5 │ LT4 │ LT3 │ LT2 │ LT1 │ LT0 │ RT0 │ RT1 │ RT2 │ RT3 │ RT4 │ RT5 │
    ___

    XXX
    XXX
    XXX
    XXX
    XXX
    ,
    XXX
    XXX
    XXX
    XXX
    XXX

    ___
    ,
// ├─────┼─────┼─────┼─────┼─────┼─────┼─────┼─────┼─────┼─────┼─────┼─────┤
// │ LM5 │ LM4 │ LM3 │ LM2 │ LM1 │ LM0 │ RM0 │ RM1 │ RM2 │ RM3 │ RM4 │ RM5 │
    ___

    XXX
    &macro_std_cpp  // S
    XXX
    &macro_browser_new_search_tab  // T
    XXX
    ,
    XXX
    XXX
    XXX
    XXX
    &macro_copy_and_toggle_app_and_paste  // P

    ___
    ,
// ├─────┼─────┼─────┼─────┼─────┼─────┼─────┼─────┼─────┼─────┼─────┼─────┤
// │ LB5 │ LB4 │ LB3 │ LB2 │ LB1 │ LB0 │ RB0 │ RB1 │ RB2 │ RB3 │ RB4 │ RB5 │
    ___

    XXX
    XXX
    XXX
    XXX
    XXX
    ,
    XXX
    XXX
    XXX
    XXX
    XXX

    ___
    ,
// ├─────┼─────┼─────┼─────┼─────┼─────┴─────┼─────┼─────┼─────┼─────┼─────┤
// │ LF5 │ LF4 │ LF3 │ LF2 │ LF1 │           │ RF1 │ RF2 │ RF3 │ RF4 │ RF5 │
     ___   ___ , ___   ___   ___       ,       ___   ___   ___ , ___   ___,
// ├─────┼─────┼─────┼─────┴─────╯           ╰─────┴─────┼─────┼─────┼─────┤
// │ LH5 │ LH4 │ LH3 │                                   │ RH3 │ RH4 │ RH5 │
     ___   ___ , ___                   ,                   ___ , ___   ___,
// ├─────┼─────┼─────┤                                   ├─────┼─────┼─────┤
// │ LH2 │ LH1 │ LH0 │                                   │ RH0 │ RH1 │ RH2 │
     ___ , ___   ___                   ,                   ___   ___ , ___
// ╰─────┴─────┴─────╯                                   ╰─────┴─────┴─────╯
)

////////////////////////////////////////////////////////////////

#define ____KEYMAP_LAYER_NAV_MOUSE

MOERGO_LAYER(layer_nav_mouse,
// ╭─────┬─────┬─────┬─────┬─────╮           ╭─────┬─────┬─────┬─────┬─────╮
// │ LC5 │ LC4 │ LC3 │ LC2 │ LC1 │           │ RC1 │ RC2 │ RC3 │ RC4 │ RC5 │
     ___   ___   ___   ___   ___       ,       ___   ___   ___   ___   ___,
// ├─────┼─────┼─────┼─────┼─────┼─────┬─────┼─────┼─────┼─────┼─────┼─────┤
// │ LN5 │ LN4 │ LN3 │ LN2 │ LN1 │ LN0 │ RN0 │ RN1 │ RN2 │ RN3 │ RN4 │ RN5 │
    ___   ___   ___   ___   ___   ___
    ,
    ___   ___   ___   ___   ___   ___
    ,

// ├─────┼─────┼─────┼─────┼─────┼─────┼─────┼─────┼─────┼─────┼─────┼─────┤
// │ LT5 │ LT4 │ LT3 │ LT2 │ LT1 │ LT0 │ RT0 │ RT1 │ RT2 │ RT3 │ RT4 │ RT5 │
    ___

    XXX
    &mkp LCLK
    &mkp MCLK
    &mkp RCLK
    XXX
    ,
    XXX
    &mmv MOVE_UP_LEFT
    &mmv MOVE_UP
    &mmv MOVE_UP_RIGHT
    XXX

    ___
    ,
// ├─────┼─────┼─────┼─────┼─────┼─────┼─────┼─────┼─────┼─────┼─────┼─────┤
// │ LM5 │ LM4 │ LM3 │ LM2 │ LM1 │ LM0 │ RM0 │ RM1 │ RM2 │ RM3 │ RM4 │ RM5 │
    ___

    &kp TAB
    &kp DELETE
    &kp UP_ARROW
    &kp BACKSPACE
    &kp KEY_CUT
    ,
    &msc SCRL_LEFT
    &mmv MOVE_LEFT
    &mmv MOVE_DOWN
    &mmv MOVE_RIGHT
    &msc SCRL_RIGHT

    ___
    ,
// ├─────┼─────┼─────┼─────┼─────┼─────┼─────┼─────┼─────┼─────┼─────┼─────┤
// │ LB5 │ LB4 │ LB3 │ LB2 │ LB1 │ LB0 │ RB0 │ RB1 │ RB2 │ RB3 │ RB4 │ RB5 │
    ___

    &kp KEY_PASTE
    &kp LEFT_ARROW
    &kp DOWN_ARROW
    &kp RIGHT_ARROW
    &kp KEY_COPY
    ,
    &msc SCRL_UP
    &mmv MOVE_DOWN_LEFT
    &mmv MOVE_DOWN
    &mmv MOVE_DOWN_RIGHT
    &msc SCRL_DOWN

    ___
    ,
// ├─────┼─────┼─────┼─────┼─────┼─────┴─────┼─────┼─────┼─────┼─────┼─────┤
// │ LF5 │ LF4 │ LF3 │ LF2 │ LF1 │           │ RF1 │ RF2 │ RF3 │ RF4 │ RF5 │
    &kp PAGE_UP
    &kp PAGE_DOWN
    ,
    &kp HOME
    &kp K_CONTEXT_MENU
    &kp END
    ,
    ___   ___   ___  , ___  ___
    ,
// ├─────┼─────┼─────┼─────┴─────╯           ╰─────┴─────┼─────┼─────┼─────┤
// │ LH5 │ LH4 │ LH3 │                                   │ RH3 │ RH4 │ RH5 │
     ___   ___ , ___                   ,                   ___ , ___   ___,
// ├─────┼─────┼─────┤                                   ├─────┼─────┼─────┤
// │ LH2 │ LH1 │ LH0 │                                   │ RH0 │ RH1 │ RH2 │
     ___ , ___   ___                   ,                   ___   ___ , ___
// ╰─────┴─────┴─────╯                                   ╰─────┴─────┴─────╯
)

////////////////////////////////////////////////////////////////

#define ____KEYMAP_LAYER_NAV

MOERGO_LAYER(layer_nav,
// ╭─────┬─────┬─────┬─────┬─────╮           ╭─────┬─────┬─────┬─────┬─────╮
// │ LC5 │ LC4 │ LC3 │ LC2 │ LC1 │           │ RC1 │ RC2 │ RC3 │ RC4 │ RC5 │
     ___   ___   ___   ___   ___       ,       ___   ___   ___   ___   ___,
// ├─────┼─────┼─────┼─────┼─────┼─────┬─────┼─────┼─────┼─────┼─────┼─────┤
// │ LN5 │ LN4 │ LN3 │ LN2 │ LN1 │ LN0 │ RN0 │ RN1 │ RN2 │ RN3 │ RN4 │ RN5 │
    &kp KEY_APP_QUIT
    &kp LC(F4)
    &kp LC(LS(TAB))
    &tri__app_switch_fw__nav_left
    &kp LC(TAB)
    &tri__app_win_switch_fw
    ,
    ___
    &tri__app_win_switch_bw
    &tri__app_switch_fw__nav_right
    &tri__app_win_switch_fw
    ___
    ___
    ,
// ├─────┼─────┼─────┼─────┼─────┼─────┼─────┼─────┼─────┼─────┼─────┼─────┤
// │ LT5 │ LT4 │ LT3 │ LT2 │ LT1 │ LT0 │ RT0 │ RT1 │ RT2 │ RT3 │ RT4 │ RT5 │
    ___

    XXX
    XXX
    XXX
    XXX
    XXX
    ,
    &kp KEY_CUT
    &kp DELETE
    &kp UP_ARROW
    &kp BACKSPACE
    &kp TAB

    ___
    ,
// ├─────┼─────┼─────┼─────┼─────┼─────┼─────┼─────┼─────┼─────┼─────┼─────┤
// │ LM5 │ LM4 │ LM3 │ LM2 │ LM1 │ LM0 │ RM0 │ RM1 │ RM2 │ RM3 │ RM4 │ RM5 │
    ___

    &kp LALT
    &kp LCTL
    XXX
    &kp LSFT
    XXX
    ,
    &kp KEY_COPY
    &kp LEFT_ARROW
    &kp DOWN_ARROW
    &kp RIGHT_ARROW
    &kp KEY_PASTE

    ___
    ,
// ├─────┼─────┼─────┼─────┼─────┼─────┼─────┼─────┼─────┼─────┼─────┼─────┤
// │ LB5 │ LB4 │ LB3 │ LB2 │ LB1 │ LB0 │ RB0 │ RB1 │ RB2 │ RB3 │ RB4 │ RB5 │
    ___

    &kp HOME
    &kp END
    &kp PAGE_UP
    &kp PAGE_DOWN
    XXX
    ,
    &kp PAGE_UP
    &kp HOME
    &kp K_CONTEXT_MENU
    &kp END
    &kp PAGE_DOWN

    ___
    ,
// ├─────┼─────┼─────┼─────┼─────┼─────┴─────┼─────┼─────┼─────┼─────┼─────┤
// │ LF5 │ LF4 │ LF3 │ LF2 │ LF1 │           │ RF1 │ RF2 │ RF3 │ RF4 │ RF5 │
     ___   ___ , ___   ___   ___       ,       ___   ___   ___ , ___   ___,
// ├─────┼─────┼─────┼─────┴─────╯           ╰─────┴─────┼─────┼─────┼─────┤
// │ LH5 │ LH4 │ LH3 │                                   │ RH3 │ RH4 │ RH5 │
     ___   ___ , ___                   ,                   ___ , ___   ___,
// ├─────┼─────┼─────┤                                   ├─────┼─────┼─────┤
// │ LH2 │ LH1 │ LH0 │                                   │ RH0 │ RH1 │ RH2 │
     ___ , ___   ___                   ,                   ___   ___ , ___
// ╰─────┴─────┴─────╯                                   ╰─────┴─────┴─────╯
)

////////////////////////////////////////////////////////////////

#define ____KEYMAP_LAYER_TEMPLATE

//// Glove80: full layout
// ╭─────┬─────┬─────┬─────┬─────╮           ╭─────┬─────┬─────┬─────┬─────╮
// │ LC5 │ LC4 │ LC3 │ LC2 │ LC1 │           │ RC1 │ RC2 │ RC3 │ RC4 │ RC5 │
// ├─────┼─────┼─────┼─────┼─────┼─────┬─────┼─────┼─────┼─────┼─────┼─────┤
// │ LN5 │ LN4 │ LN3 │ LN2 │ LN1 │ LN0 │ RN0 │ RN1 │ RN2 │ RN3 │ RN4 │ RN5 │
// ├─────┼─────┼─────┼─────┼─────┼─────┼─────┼─────┼─────┼─────┼─────┼─────┤
// │ LT5 │ LT4 │ LT3 │ LT2 │ LT1 │ LT0 │ RT0 │ RT1 │ RT2 │ RT3 │ RT4 │ RT5 │
// ├─────┼─────┼─────┼─────┼─────┼─────┼─────┼─────┼─────┼─────┼─────┼─────┤
// │ LM5 │ LM4 │ LM3 │ LM2 │ LM1 │ LM0 │ RM0 │ RM1 │ RM2 │ RM3 │ RM4 │ RM5 │
// ├─────┼─────┼─────┼─────┼─────┼─────┼─────┼─────┼─────┼─────┼─────┼─────┤
// │ LB5 │ LB4 │ LB3 │ LB2 │ LB1 │ LB0 │ RB0 │ RB1 │ RB2 │ RB3 │ RB4 │ RB5 │
// ├─────┼─────┼─────┼─────┼─────┼─────┴─────┼─────┼─────┼─────┼─────┼─────┤
// │ LF5 │ LF4 │ LF3 │ LF2 │ LF1 │           │ RF1 │ RF2 │ RF3 │ RF4 │ RF5 │
// ├─────┼─────┼─────┼─────┴─────╯           ╰─────┴─────┼─────┼─────┼─────┤
// │ LH5 │ LH4 │ LH3 │                                   │ RH3 │ RH4 │ RH5 │
// ├─────┼─────┼─────┤                                   ├─────┼─────┼─────┤
// │ LH2 │ LH1 │ LH0 │                                   │ RH0 │ RH1 │ RH2 │
// ╰─────┴─────┴─────╯                                   ╰─────┴─────┴─────╯
//// Go60: floor and thumb keys
// ╭───────────┬─────┬─────┬─────╮           ╭─────┬─────┬─────┬───────────╮
// │           │ LF3 │ LF2 │ LF1 │           │ RF1 │ RF2 │ RF3 │           │
// ├─────┬─────┼─────┼─────┴─────╯           ╰─────┴─────┼─────┼─────┬─────┤
// │ LH5 │ LH4 │ LH2 │                                   │ RH2 │ RH4 │ RH5 │
// ╰─────┴─────┴─────╯                                   ╰─────┴─────┴─────╯
//

MOERGO_LAYER(_layer_template,
// ╭─────┬─────┬─────┬─────┬─────╮           ╭─────┬─────┬─────┬─────┬─────╮
// │ LC5 │ LC4 │ LC3 │ LC2 │ LC1 │           │ RC1 │ RC2 │ RC3 │ RC4 │ RC5 │
     ___   ___   ___   ___   ___       ,       ___   ___   ___   ___   ___,
// ├─────┼─────┼─────┼─────┼─────┼─────┬─────┼─────┼─────┼─────┼─────┼─────┤
// │ LN5 │ LN4 │ LN3 │ LN2 │ LN1 │ LN0 │ RN0 │ RN1 │ RN2 │ RN3 │ RN4 │ RN5 │
     ___   ___   ___   ___   ___   ___ , ___   ___   ___   ___   ___   ___,
// ├─────┼─────┼─────┼─────┼─────┼─────┼─────┼─────┼─────┼─────┼─────┼─────┤
// │ LT5 │ LT4 │ LT3 │ LT2 │ LT1 │ LT0 │ RT0 │ RT1 │ RT2 │ RT3 │ RT4 │ RT5 │
     ___   XXX   XXX   XXX   XXX   XXX , XXX   XXX   XXX   XXX   XXX   ___,
// ├─────┼─────┼─────┼─────┼─────┼─────┼─────┼─────┼─────┼─────┼─────┼─────┤
// │ LM5 │ LM4 │ LM3 │ LM2 │ LM1 │ LM0 │ RM0 │ RM1 │ RM2 │ RM3 │ RM4 │ RM5 │
     ___   XXX   XXX   XXX   XXX   XXX , XXX   XXX   XXX   XXX   XXX   ___,
// ├─────┼─────┼─────┼─────┼─────┼─────┼─────┼─────┼─────┼─────┼─────┼─────┤
// │ LB5 │ LB4 │ LB3 │ LB2 │ LB1 │ LB0 │ RB0 │ RB1 │ RB2 │ RB3 │ RB4 │ RB5 │
     ___   XXX   XXX   XXX   XXX   XXX , XXX   XXX   XXX   XXX   XXX   ___,
// ├─────┼─────┼─────┼─────┼─────┼─────┴─────┼─────┼─────┼─────┼─────┼─────┤
// │ LF5 │ LF4 │ LF3 │ LF2 │ LF1 │           │ RF1 │ RF2 │ RF3 │ RF4 │ RF5 │
     ___   ___ , ___   ___   ___       ,       ___   ___   ___ , ___   ___,
// ├─────┼─────┼─────┼─────┴─────╯           ╰─────┴─────┼─────┼─────┼─────┤
// │ LH5 │ LH4 │ LH3 │                                   │ RH3 │ RH4 │ RH5 │
     ___   ___ , ___                   ,                   ___ , ___   ___,
// ├─────┼─────┼─────┤                                   ├─────┼─────┼─────┤
// │ LH2 │ LH1 │ LH0 │                                   │ RH0 │ RH1 │ RH2 │
     ___ , ___   ___                   ,                   ___   ___ , ___
// ╰─────┴─────┴─────╯                                   ╰─────┴─────┴─────╯
)

////////////////////////////////////////////////////////////////
////////////////////////////////
////////////////
////////
////
//
